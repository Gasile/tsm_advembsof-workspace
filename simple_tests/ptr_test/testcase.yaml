## simple_tests/ptr_test/testcase.yaml
```yaml
tests:
  simple_tests.ptr_test:
    tags:
      - cpp
    extra_conf_files: 
      - ../../deps/zpp_lib/configs/prj.conf
      - ../../deps/zpp_lib/configs/prj_log.conf
      - ../../deps/zpp_lib/configs/prj_debug.conf
      - ../../deps/zpp_lib/configs/prj_test.conf
```

## twister-out.1/qemu_x86_atom/zephyr_gnu/simple_tests/always_succeed/simple_tests.always_succeed/Kconfig/boards/Kconfig.qemu_x86.tmp
```kconfig
# Load board Kconfig descriptions.
osource "/home/gasile/Documents/MASTER/AdvEmbSof/tsm_advembsof-workspace/deps/zephyr/boards/qemu/x86/Kconfig.qemu_x86"
```

## twister-out.1/qemu_x86_atom/zephyr_gnu/simple_tests/ptr_test/simple_tests.ptr_test/Kconfig/boards/Kconfig.defconfig
```kconfig
# Load Zephyr board defconfig descriptions.
osource "/home/gasile/Documents/MASTER/AdvEmbSof/tsm_advembsof-workspace/deps/zephyr/boards/qemu/x86/Kconfig.defconfig"
```

## twister-out.2/nrf5340dk_nrf5340_cpuapp/zephyr_gnu/zpp_lib/zpp_rtos/tests/mutex/zpp_lib.zpp_rtos.mutex/Kconfig/boards/Kconfig
```kconfig
# Load Zephyr board Kconfig descriptions.
osource "/home/gasile/Documents/MASTER/AdvEmbSof/tsm_advembsof-workspace/deps/zephyr/boards/nordic/nrf5340dk/Kconfig"
```

## twister-out.2/nrf5340dk_nrf5340_cpuapp/zephyr_gnu/zpp_lib/zpp_rtos/tests/semaphore/zpp_lib.zpp_rtos.semaphore/Kconfig/Kconfig.modules
```kconfig
menu "zpp_lib (/home/gasile/Documents/MASTER/AdvEmbSof/tsm_advembsof-workspace/deps/zpp_lib)"
osource "/home/gasile/Documents/MASTER/AdvEmbSof/tsm_advembsof-workspace/deps/zpp_lib/zephyr/Kconfig"
config ZEPHYR_ZPP_LIB_MODULE
	bool
	default y
endmenu
menu "cmsis_6 (/home/gasile/Documents/MASTER/AdvEmbSof/tsm_advembsof-workspace/deps/modules/hal/cmsis_6)"
osource "$(ZEPHYR_CMSIS_6_KCONFIG)"
config ZEPHYR_CMSIS_6_MODULE
	bool
	default y
endmenu
menu "hal_nordic (/home/gasile/Documents/MASTER/AdvEmbSof/tsm_advembsof-workspace/deps/modules/hal/nordic)"
osource "$(ZEPHYR_HAL_NORDIC_KCONFIG)"
config ZEPHYR_HAL_NORDIC_MODULE
	bool
	default y

config ZEPHYR_HAL_NORDIC_MODULE_BLOBS
	bool
endmenu
```

## twister-out.2/nrf5340dk_nrf5340_cpuapp/zephyr_gnu/zpp_lib/zpp_rtos/tests/thread/zpp_lib.zpp_rtos.thread/Kconfig/boards/Kconfig.defconfig
```kconfig
# Load Zephyr board defconfig descriptions.
osource "/home/gasile/Documents/MASTER/AdvEmbSof/tsm_advembsof-workspace/deps/zephyr/boards/nordic/nrf5340dk/Kconfig.defconfig"
```

## twister-out/nrf5340dk_nrf5340_cpuapp/zephyr_gnu/simple_tests/always_succeed/simple_tests.always_succeed/Kconfig/boards/Kconfig.nrf5340dk
```kconfig
# Load board Kconfig descriptions.
osource "/home/gasile/Documents/MASTER/AdvEmbSof/tsm_advembsof-workspace/deps/zephyr/boards/nordic/nrf5340dk/Kconfig.nrf5340dk"
```
